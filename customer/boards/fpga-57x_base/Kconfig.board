## customer/boards/fpga-57x_base/Kconfig.board
```kconfig
config FPGA
    bool 
    default y 

config TOUCH_IRQ_PIN
    int
    default 33

config LCD_BACKLIGHT_CONTROL_PIN
    int
    default 70
    
config CAMERA_I2C_DEVICE_NAME
    string
    default "i2c2"

config EPD_TPS_I2C_DEVICE_NAME
    string
    default "i2c1"
```
